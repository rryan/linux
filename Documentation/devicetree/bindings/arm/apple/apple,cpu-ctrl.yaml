## Documentation/devicetree/bindings/arm/apple/apple,cpu-ctrl.yaml
```yaml
# SPDX-License-Identifier: (GPL-2.0-only OR BSD-2-Clause)
%YAML 1.2
---
$id: http://devicetree.org/schemas/arm/apple/apple,cpu-ctrl.yaml#
$schema: http://devicetree.org/meta-schemas/core.yaml#

title: Apple SoC CPU power controls

maintainers:
  - RJ Skerry-Ryan <rryan@alum.mit.edu>

description: |
  The Apple PMGR stops and starts individual CPU cores and powers CPU
  clusters up and down. A started core comes out of reset at its RVBAR.
  Secondary CPUs are brought up by the boot loader through a spin table;
  with these controls they can also be taken offline and restarted.

  This node collects the PMGR CPU start/stop registers and the CPU complex
  (ACC) registers of each cluster, which must be re-initialised after the
  cluster loses power. The cluster power states live in the PMGR and are
  referenced through a phandle.

  CPU nodes refer to this node with the "apple,cpu-ctrl" property, which
  also gives the cluster and core index of the CPU, and give the physical
  address of their implementation registers (RVBAR and core status) in
  "apple,cpu-impl-reg".

properties:
  $nodename:
    pattern: "^cpu-ctrl@[0-9a-f]+$"

  compatible:
    const: apple,t6020-cpu-ctrl

  reg:
    minItems: 1
    items:
      - description: PMGR CPU start/stop registers
      - description: CPU complex registers of cluster 0
      - description: CPU complex registers of cluster 1
      - description: CPU complex registers of cluster 2

  reg-names:
    minItems: 1
    items:
      - const: cpu-start
      - const: acc0
      - const: acc1
      - const: acc2

  apple,pmgr:
    $ref: /schemas/types.yaml#/definitions/phandle
    description:
      PMGR syscon holding the CPU cluster power states. Without it, and
      without a cluster's CPU complex registers, that cluster is never
      powered down.

required:
  - compatible
  - reg
  - reg-names

additionalProperties: false

examples:
  - |
    soc {
        #address-cells = <2>;
        #size-cells = <2>;

        cpu_ctrl: cpu-ctrl@28e0a8000 {
            compatible = "apple,t6020-cpu-ctrl";
            reg = <0x2 0x8e0a8000 0x0 0x40>,
                  <0x2 0x10e00000 0x0 0x50000>,
                  <0x2 0x11e00000 0x0 0x50000>,
                  <0x2 0x12e00000 0x0 0x50000>;
            reg-names = "cpu-start", "acc0", "acc1", "acc2";
            apple,pmgr = <&pmgr>;
        };
    };
```

## Documentation/devicetree/bindings/power/apple,pmgr-s2r.yaml
```yaml
# SPDX-License-Identifier: (GPL-2.0-only OR BSD-2-Clause)
%YAML 1.2
---
$id: http://devicetree.org/schemas/power/apple,pmgr-s2r.yaml#
$schema: http://devicetree.org/meta-schemas/core.yaml#

title: Apple SoC suspend-to-RAM controls

maintainers:
  - RJ Skerry-Ryan <rryan@alum.mit.edu>

description: |
  Entering suspend-to-RAM on Apple SoCs takes, once every device and every
  secondary CPU is down, a final PMGR sequence on the boot CPU: power down
  the CPU clusters, switch the SoC clock generators off their PLL, put the
  PLL into its off mode and start the PMGR suspend-to-RAM timer. The boot
  CPU then enters a non-retention WFI and the SoC goes to sleep. On wake
  the boot CPU restarts at its reset vector and the SEP power state has to
  be forced back on.

  This node describes the registers for that sequence that are not part of
  a PMGR syscon, and references the rest by phandle.

  Resuming needs boot firmware that hands the boot CPU's reset vector back
  to the kernel. Such firmware advertises a warm boot mailbox in the
  64-bit /chosen/asahi,s2r-mailbox property: the physical address of four
  little-endian u64 words, magic (0x21523253316e316d arms the warm boot
  path; firmware clears it once taken), entry (physical address to branch
  to at EL2 with the MMU off), arg (passed in x0) and flags (bit 0: keep
  the firmware console quiet on CPU reset entries; bit 1: redo CPU cluster
  frequency init; bit 2: redo memory cache controller init; bit 63: set by
  firmware when it took the warm boot path). The region is reserved
  memory. Without the property, suspend-to-RAM is not offered.

properties:
  $nodename:
    pattern: "^power-management@[0-9a-f]+$"

  compatible:
    const: apple,t6021-pmgr-s2r

  reg:
    items:
      - description: SoC clock generator
      - description: SoC PLL off-mode control
      - description: PMGR suspend-to-RAM timer

  reg-names:
    items:
      - const: clkgen
      - const: pll
      - const: s2r-timer

  apple,pmgr:
    $ref: /schemas/types.yaml#/definitions/phandle
    description: PMGR syscon holding the SoC cluster power controls

  apple,cpu-clusters:
    $ref: /schemas/types.yaml#/definitions/uint32-array
    minItems: 1
    maxItems: 8
    description:
      Physical SoC cluster IDs of the CPU clusters, in power-down order

  apple,sep-domain:
    $ref: /schemas/types.yaml#/definitions/phandle
    description: SEP power state node, forced back on after wake

  apple,watchdog:
    $ref: /schemas/types.yaml#/definitions/phandle
    description:
      System watchdog. For bring-up it can be armed right before the SoC
      goes to sleep, so that a suspend-to-RAM that never resumes ends in a
      reset. Its registers stay owned by the watchdog's own node.

required:
  - compatible
  - reg
  - reg-names
  - apple,pmgr
  - apple,cpu-clusters
  - apple,sep-domain

additionalProperties: false

examples:
  - |
    soc {
        #address-cells = <2>;
        #size-cells = <2>;

        power-management@28e038000 {
            compatible = "apple,t6021-pmgr-s2r";
            reg = <0x2 0x8e038000 0x0 0x1000>,
                  <0x2 0x8e224000 0x0 0x4>,
                  <0x2 0x9e5c4000 0x0 0x4>;
            reg-names = "clkgen", "pll", "s2r-timer";
            apple,pmgr = <&pmgr>;
            apple,cpu-clusters = <0 1 2>;
            apple,sep-domain = <&ps_sep>;
            apple,watchdog = <&wdt>;
        };
    };
```

## Documentation/devicetree/bindings/power/apple,pmgr-sleep.yaml
```yaml
# SPDX-License-Identifier: (GPL-2.0-only OR BSD-2-Clause)
%YAML 1.2
---
$id: http://devicetree.org/schemas/power/apple,pmgr-sleep.yaml#
$schema: http://devicetree.org/meta-schemas/core.yaml#

title: Apple SoC PMGR system sleep controls

maintainers:
  - RJ Skerry-Ryan <rryan@alum.mit.edu>

description: |
  The Apple PMGR counts entries into, and time spent in, each SoC sleep
  state (DDR self-refresh, suspend-to-RAM, deep wait, ...), records how long
  the SoC took to leave its last sleep and latches the sources that woke the
  application processors. It also has controls, outside the individual
  device power states, that take further parts of the SoC down during
  system sleep: the non-CPU SoC clusters, the CPM power domain gating and
  the auto-enable behaviour of the SIO power states.

  This node collects those registers. Registers that live inside a PMGR
  syscon are referenced through phandles rather than mapped again.

properties:
  $nodename:
    pattern: "^power-management@[0-9a-f]+$"

  compatible:
    const: apple,t6020-pmgr-sleep

  reg:
    minItems: 1
    items:
      - description: PMGR sleep-state event counters
      - description: always-on GPU fabric configuration
      - description: CPM control and power domain gating
      - description: AP wake source masks and latched wake sources
      - description: PMGR counters holding the sleep exit times

  reg-names:
    minItems: 1
    items:
      - const: events
      - const: aon-gfx
      - const: cpm
      - const: wake
      - const: wake-time

  apple,pmgr:
    $ref: /schemas/types.yaml#/definitions/phandle
    description: PMGR syscon holding the SoC cluster power controls

  apple,soc-clusters:
    $ref: /schemas/types.yaml#/definitions/uint32-array
    minItems: 1
    maxItems: 8
    description:
      Physical IDs of the non-CPU SoC clusters that may be powered down
      during system sleep, in power-down order. They are powered back up in
      the reverse order.

  apple,sio-domains:
    $ref: /schemas/types.yaml#/definitions/phandle-array
    minItems: 1
    maxItems: 4
    items:
      maxItems: 1
    description:
      SIO power state nodes whose auto-enable is cleared during system sleep

  apple,afr-domain:
    $ref: /schemas/types.yaml#/definitions/phandle
    description: Media fabric (AFR) power state node

  apple,afr-dependents:
    $ref: /schemas/types.yaml#/definitions/phandle-array
    minItems: 1
    maxItems: 8
    items:
      maxItems: 1
    description:
      Power state nodes behind the AFR; the AFR is only turned off when all
      of these are powered down

  apple,ap-wake-sources:
    $ref: /schemas/types.yaml#/definitions/uint32-array
    minItems: 1
    maxItems: 263
    items:
      maximum: 262
    description:
      Bit numbers of the AP wake sources allowed to wake the application
      processors from suspend-to-RAM. Every other source is masked while
      the SoC is in suspend-to-RAM.

required:
  - compatible
  - reg
  - reg-names

dependentRequired:
  apple,soc-clusters: [ "apple,pmgr" ]
  apple,afr-dependents: [ "apple,afr-domain" ]

additionalProperties: false

examples:
  - |
    soc {
        #address-cells = <2>;
        #size-cells = <2>;

        power-management@29e2c8000 {
            compatible = "apple,t6020-pmgr-sleep";
            reg = <0x2 0x9e2c8000 0x0 0x1000>,
                  <0x2 0x9e2cd010 0x0 0x4>,
                  <0x2 0x8e08c000 0x0 0x40>,
                  <0x2 0x9e004000 0x0 0x60>,
                  <0x2 0x8e0e0000 0x0 0x1000>;
            reg-names = "events", "aon-gfx", "cpm", "wake", "wake-time";
            apple,pmgr = <&pmgr>;
            apple,soc-clusters = <3 5 4 6>;
            apple,sio-domains = <&ps_sio>, <&ps_sio_cpu>;
            apple,afr-domain = <&ps_afr>;
            apple,afr-dependents = <&ps_gfx>, <&ps_dispext0_sys>;
            apple,ap-wake-sources = <12 14 26 27 40 43 49 50 51 52 54 85 90
                                     126 127 128 129 130 131 132 133 223>;
        };
    };
```
